## blinky/sample.yaml
```yaml
sample:
  name: PWM Fading Blinky Sample
tests:
  sample.basic.pwm_fading_blinky:
    tags:
      - LED
      - pwm
    filter: dt_enabled_alias_with_parent_compat("pwm-led0", "pwm-leds")
    depends_on: pwm
    harness: led
    integration_platforms:
      - nrf5340dk_nrf5340_cpuapp
```
